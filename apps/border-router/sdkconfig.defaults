## apps/border-router/sdkconfig.defaults
```kconfig
CONFIG_NVS_ENCRYPTION=y
CONFIG_NVS_SEC_KEY_PROTECT_USING_HMAC=y
CONFIG_NVS_SEC_HMAC_EFUSE_KEY_ID=0
CONFIG_LWIP_NETIF_HOSTNAME=y
CONFIG_HTTPD_MAX_REQ_HDR_LEN=2048
```

## components/lnot_common/Kconfig
```kconfig
menu "LocoNet over Thread"

config LNOT_HEARTBEAT_INTERVAL_SECONDS
    int "Heartbeat interval in seconds"
    range 1 86400
    default 30
    help
        Interval used by the minimal firmware to emit a serial health message.

endmenu
```
